// Definitions for several I2C based EEPROM
/dts-v1/;
/plugin/;

/ {
        compatible = "brcm,bcm2835";

        fragment@0 {
                target = <&i2cbus>;
                __dormant__ {
                        #address-cells = <1>;
                        #size-cells = <0>;
                        
                        at24c256: at24c256@50 {
                                compatible = "atmel,24c256";
                                reg = <0x50>;
                                pagesize = <64>;
                        };
                };      
        };

        fragment@1 {
                target = <&i2cbus6>;
                __dormant__ {
                        #address-cells = <1>;
                        #size-cells = <0>;
                        
                        at24c256_6: at24c256@50 {
                                compatible = "atmel,24c256";
                                reg = <0x50>;
                                pagesize = <64>;
                        };
                };      
        };

        fragment@2 {
                target = <&i2cbus>;
                __dormant__ {
                        #address-cells = <1>;
                        #size-cells = <0>;
                        
                        at24c16: at24c16@50 {
                                compatible = "atmel,24c16";
                                reg = <0x50>;
                                pagesize = <16>;
                        };
                };      
        };

        fragment@3 {
                target = <&i2cbus6>;
                __dormant__ {
                        #address-cells = <1>;
                        #size-cells = <0>;
                        
                        at24c16_6: at24c16@50 {
                                compatible = "atmel,24c16";
                                reg = <0x50>;
                                pagesize = <16>;
                        };
                };      
        };

        fragment@4 {
                target = <&i2cbus>;
                __dormant__ {
                        #address-cells = <1>;
                        #size-cells = <0>;
                        
                        at24c32: at24c32@50 {
                                compatible = "atmel,24c32";
                                reg = <0x50>;
                                pagesize = <32>;//32-Byte Page Write Mode from datasheet
                        };
                };      
        };

        fragment@5 {
                target = <&i2cbus6>;
                __dormant__ {
                        #address-cells = <1>;
                        #size-cells = <0>;
                        
                        at24c32_6: at24c32@50 {
                                compatible = "atmel,24c32";
                                reg = <0x50>;
                                pagesize = <32>;//32-Byte Page Write Mode from datasheet
                        };
                };      
        };

	frag100: fragment@100 {
		target = <&i2c_arm>;
		i2cbus: __overlay__ {
			status = "okay";
		};
	};

	fragment@101 {
		target = <&i2c0if>;
		__dormant__ {
			status = "okay";
		};
	};

	fragment@102 {
		target = <&i2c0mux>;
		__dormant__ {
			status = "okay";
		};
	};

	frag200: fragment@200 {
		target = <&i2c_csi_dsi0>;
		i2cbus6: __overlay__ {
			status = "okay";
		};
	};

	__overrides__ {
                at24c256 = <0>,"+0+1";
                at24c16 = <0>,"+2+3";
                at24c32 = <0>,"+4+5";
	};
};
